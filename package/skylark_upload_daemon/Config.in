## package/skylark_upload_daemon/Config.in
```kconfig
config BR2_PACKAGE_SKYLARK_UPLOAD_DAEMON
  bool "skylark_upload_daemon"
  select BR2_PACKAGE_CZMQ
  select BR2_PACKAGE_LIBSBP
  select BR2_PACKAGE_LIBPIKSI
  select BR2_PACKAGE_LIBCURL
  select BR2_PACKAGE_LIBSKYLARK
```

## package/standalone_file_logger/Config.in
```kconfig
config BR2_PACKAGE_STANDALONE_FILE_LOGGER
	bool "standalone_file_logger"
	select BR2_PACKAGE_LIBUV
	select BR2_PACKAGE_NANOMSG
	select BR2_PACKAGE_LIBSBP
	select BR2_PACKAGE_LIBPIKSI
	select BR2_PACKAGE_GTEST if BR2_BUILD_TESTS
```

## package/starling_daemon/Config.in
```kconfig
config BR2_PACKAGE_STARLING_DAEMON
  bool "starling_daemon"
  select BR2_PACKAGE_LIBUV
  select BR2_PACKAGE_LIBSBP
  select BR2_PACKAGE_LIBPIKSI
```

## package/uboot_custom/Config.in
```kconfig
config BR2_PACKAGE_UBOOT_CUSTOM
	bool "uboot_custom"
	select BR2_PACKAGE_HOST_DTC
	select BR2_PACKAGE_HOST_UBOOT_TOOLS

if BR2_PACKAGE_UBOOT_CUSTOM
config BR2_PACKAGE_UBOOT_CUSTOM_CONFIGS
	string "Configs to build"
endif
```

## package/upgrade_tool/Config.in
```kconfig
config BR2_PACKAGE_UPGRADE_TOOL
	bool "upgrade_tool"
	select BR2_PACKAGE_UBOOT_CUSTOM
	select BR2_PACKAGE_ZLIB
```

## package/watchdog_daemon/Config.in
```kconfig
config BR2_PACKAGE_WATCHDOG_DAEMON
  bool "watchdog_daemon"
  select BR2_PACKAGE_LIBPIKSI
```

## package/zmq_adapter/Config.in
```kconfig
config BR2_PACKAGE_ZMQ_ADAPTER
	bool "zmq_adapter"
	select BR2_PACKAGE_CMPH
	select BR2_PACKAGE_CZMQ
	select BR2_PACKAGE_LIBSBP
```

## package/zmq_router/Config.in
```kconfig
config BR2_PACKAGE_ZMQ_ROUTER
	bool "zmq_router"
	select BR2_PACKAGE_LIBUV
	select BR2_PACKAGE_CZMQ
	select BR2_PACKAGE_LIBSBP
	select BR2_PACKAGE_LIBPIKSI
	select BR2_PACKAGE_LIBYAML
```
