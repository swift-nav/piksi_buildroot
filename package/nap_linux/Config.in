## package/nav_daemon/Config.in
```kconfig
config BR2_PACKAGE_NAV_DAEMON
  bool "nav_daemon"
  select BR2_PACKAGE_CZMQ
  select BR2_PACKAGE_LIBSBP
  select BR2_PACKAGE_LIBPIKSI
```

## package/navengine/Config.in
```kconfig
config BR2_PACKAGE_NAVENGINE
	bool "navengine"
	select BR2_PACKAGE_C_ARES
	select BR2_PACKAGE_EIGEN
	select BR2_PACKAGE_GTEST
	select BR2_PACKAGE_GFLAGS
	select BR2_PACKAGE_LIBCURL
	select BR2_PACKAGE_LIBSBP
	select BR2_PACKAGE_LIBSERIALPORT
	select BR2_PACKAGE_LIBSKYLARK
	select BR2_PACKAGE_LIBSWIFTNAV
	select BR2_PACKAGE_OPENSSL
	select BR2_PACKAGE_ZLIB
	depends on BR2_INSTALL_LIBSTDCPP
	depends on BR2_TOOLCHAIN_HAS_THREADS

	help
	  Swift Navigation NavEngine

	  https://github.com/swift-nav/navengine

if BR2_PACKAGE_NAVENGINE

comment "navengine needs a toolchain w/ C++, threads"
	depends on !BR2_INSTALL_LIBSTDCPP || !BR2_TOOLCHAIN_HAS_THREADS

endif
```

## package/network_daemon/Config.in
```kconfig
config BR2_PACKAGE_NETWORK_DAEMON
  bool "network_daemon"
  select BR2_PACKAGE_LIBUV
  select BR2_PACKAGE_CZMQ
  select BR2_PACKAGE_LIBSBP
  select BR2_PACKAGE_LIBPIKSI
```

## package/nmea_daemon/Config.in
```kconfig
config BR2_PACKAGE_NMEA_DAEMON
	bool "nmea_daemon"
	select BR2_PACKAGE_CZMQ
	select BR2_PACKAGE_LIBPIKSI
	select BR2_PACKAGE_GNSS_CONVERTERS
```

## package/ntrip_daemon/Config.in
```kconfig
config BR2_PACKAGE_NTRIP_DAEMON
  bool "ntrip_daemon"
  select BR2_PACKAGE_LIBUV
  select BR2_PACKAGE_LIBSBP
  select BR2_PACKAGE_LIBPIKSI
  select BR2_PACKAGE_LIBCURL
  select BR2_PACKAGE_LIBNETWORK
```

## package/ntrip_source_daemon/Config.in
```kconfig
config BR2_PACKAGE_NTRIP_SOURCE_DAEMON
  bool "ntrip_source_daemon"
  select BR2_PACKAGE_CZMQ
  select BR2_PACKAGE_LIBSBP
  select BR2_PACKAGE_LIBPIKSI
  select BR2_PACKAGE_LIBCURL
  select BR2_PACKAGE_LIBNETWORK
```

## package/orion_daemon/Config.in
```kconfig
config BR2_PACKAGE_ORION_DAEMON
  bool "orion_daemon"
  select BR2_PACKAGE_LIBUV
  select BR2_PACKAGE_NANOMSG_CUSTOM
  select BR2_PACKAGE_LIBSBP
  select BR2_PACKAGE_LIBPIKSI
  select BR2_PACKAGE_PROTOBUF_CUSTOM
  select BR2_PACKAGE_GRPC_CUSTOM
```

## package/ota_daemon/Config.in
```kconfig
config BR2_PACKAGE_OTA_DAEMON
  bool "ota_daemon"
  select BR2_PACKAGE_JSON_C
  select BR2_PACKAGE_LIBUV
  select BR2_PACKAGE_LIBSBP
  select BR2_PACKAGE_LIBPIKSI
  select BR2_PACKAGE_LIBCURL
  select BR2_PACKAGE_LIBNETWORK
```

## package/ota_tool/Config.in
```kconfig
config BR2_PACKAGE_OTA_TOOL
 	bool "ota_tool"
 	depends on BR2_PACKAGE_HOST_RUSTC_ARCH_SUPPORTS
 	select BR2_PACKAGE_HOST_RUSTC
 	select BR2_PACKAGE_HOST_CARGO
```

## package/pfw_welcome/Config.in
```kconfig
config BR2_PACKAGE_PFW_WELCOME
  # This has been disabled as of 1.6/2.0 to
  # avoid blocking boot/watchdog disable when
  # other processes are interacting with the
  # messaging. May re-enable in future if it
  # is clear what the package is attempting
  # to acheive by blocking in the init script
  bool "pfw_welcome"
  select BR2_PACKAGE_LIBUV
  select BR2_PACKAGE_LIBPIKSI
```

## package/piksi_apps/Config.in
```kconfig
config BR2_PACKAGE_PIKSI_APPS
	bool "piksi_apps"
  select BR2_PACKAGE_LIBSBP
  select BR2_PACKAGE_LIBSETTINGS
  select BR2_PACKAGE_LIBSWIFTNAV
  select BR2_PACKAGE_LIBRTCM
  select BR2_PACKAGE_GNSS_CONVERTERS
  select BR2_PACKAGE_JSON_C
  select BR2_PACKAGE_LIBUV
  select BR2_PACKAGE_VALGRIND if BR2_BUILD_TESTS
  select BR2_PACKAGE_LIBYAML
  select BR2_PACKAGE_LIBCURL
  select BR2_PACKAGE_LIBSOCKETCAN
  select BR2_PACKAGE_IPROUTE2
  select BR2_PACKAGE_LIBMNL
  select BR2_PACKAGE_LIBNFNETLINK
  select BR2_PACKAGE_SOCKETCAN
  select BR2_PACKAGE_CAN_UTILS
```

## package/piksi_dev_tools/Config.in
```kconfig
config BR2_PACKAGE_PIKSI_DEV_TOOLS
	bool "piksi_dev_tools"
	select BR2_PACKAGE_DROPBEAR
	select BR2_PACKAGE_STRESS
	select BR2_PACKAGE_STRACE
	select BR2_PACKAGE_HOST_LLVM_VANILLA
	select BR2_PACKAGE_BLACKMAGIC
```

## package/piksi_ins/Config.in
```kconfig
config BR2_PACKAGE_PIKSI_INS
  bool "piksi_ins"
  select BR2_PACKAGE_LIBUV
  select BR2_PACKAGE_LIBSBP
  select BR2_PACKAGE_LIBPIKSI
  select BR2_PACKAGE_LIBSWIFTNAV
  select BR2_PACKAGE_EIGEN
  select BR2_PACKAGE_EIGEN_UNSUPPORTED_MODULES
	select BR2_PACKAGE_PIKSI_APPS
```

## package/piksi_ins_ref/Config.in
```kconfig
config BR2_PACKAGE_PIKSI_INS_REF
	bool "piksi_ins_ref"
	select BR2_INSTALL_LIBSTDCPP if BR2_BUILD_TESTS
```

## package/piksi_leds/Config.in
```kconfig
config BR2_PACKAGE_PIKSI_LEDS
	bool "piksi_leds"
    select BR2_PACKAGE_LIBUV
	select BR2_PACKAGE_LIBSBP
	select BR2_PACKAGE_LIBPIKSI
```

## package/piksi_sample/Config.in
```kconfig
config BR2_PACKAGE_PIKSI_SAMPLE
	bool "piksi_sample"
	select BR2_PACKAGE_CZMQ
	select BR2_PACKAGE_LIBSBP
	select BR2_PACKAGE_LIBPIKSI
```

## package/piksi_system_daemon/Config.in
```kconfig
config BR2_PACKAGE_PIKSI_SYSTEM_DAEMON
	bool "piksi_system_daemon"
	select BR2_PACKAGE_CZMQ
	select BR2_PACKAGE_LIBSBP
	select BR2_PACKAGE_LIBSBP_ZMQ
	select BR2_PACKAGE_LIBSBP_SETTINGS
```

## package/ports_daemon/Config.in
```kconfig
config BR2_PACKAGE_PORTS_DAEMON
  bool "ports_daemon"
  select BR2_PACKAGE_LIBUV
  select BR2_PACKAGE_LIBSBP
  select BR2_PACKAGE_LIBPIKSI
  select BR2_PACKAGE_LIBSOCKETCAN
  select BR2_PACKAGE_IPROUTE2
  select BR2_PACKAGE_LIBMNL
  select BR2_PACKAGE_LIBNFNETLINK
  select BR2_PACKAGE_SOCKETCAN
  select BR2_PACKAGE_CAN_UTILS
```

## package/query_config/Config.in
```kconfig
config BR2_PACKAGE_QUERY_CONFIG
  bool "query_config"
  select BR2_PACKAGE_LIBUV
  select BR2_PACKAGE_LIBSBP
  select BR2_PACKAGE_LIBPIKSI
```
