## package/endpoint_router/Config.in
```kconfig
config BR2_PACKAGE_ENDPOINT_ROUTER
	bool "endpoint_router"
	select BR2_PACKAGE_LIBUV
	select BR2_PACKAGE_NANOMSG
	select BR2_PACKAGE_LIBSBP
	select BR2_PACKAGE_LIBPIKSI
	select BR2_PACKAGE_LIBYAML
```

## package/factory_data_tool/Config.in
```kconfig
config BR2_PACKAGE_FACTORY_DATA_TOOL
	bool "factory_data_tool"
	select BR2_PACKAGE_UBOOT_CUSTOM
	select BR2_PACKAGE_ZLIB
```

## package/fpga_error_moni/Config.in
```kconfig
config BR2_PACKAGE_FPGA_ERROR_MONI
	bool "fpga_error_moni"
	select BR2_PACKAGE_CZMQ
	select BR2_PACKAGE_LIBPIKSI
```

## package/gnss_converters/Config.in
```kconfig
config BR2_PACKAGE_GNSS_CONVERTERS
	bool "gnss_converters"
	select BR2_PACKAGE_LIBSBP
	select BR2_PACKAGE_LIBRTCM
	select BR2_PACKAGE_LIBSWIFTNAV
```

## package/gnss_convertors/Config.in
```kconfig
config BR2_PACKAGE_GNSS_CONVERTORS
	bool "gnss_convertors"
	select BR2_PACKAGE_LIBSBP
	select BR2_PACKAGE_LIBRTCM
	select BR2_PACKAGE_LIBSWIFTNAV
```

## package/grpc_custom/Config.in
```kconfig
config BR2_PACKAGE_GRPC_CUSTOM
	bool "grpc_custom"
	depends on BR2_INSTALL_LIBSTDCPP
	depends on BR2_TOOLCHAIN_HAS_THREADS
	select BR2_PACKAGE_CARES_CUSTOM
	select BR2_PACKAGE_C_ARES
	select BR2_PACKAGE_GFLAGS
	select BR2_PACKAGE_GTEST
	select BR2_PACKAGE_GTEST_GMOCK
	select BR2_PACKAGE_OPENSSL
	select BR2_PACKAGE_PROTOBUF_CUSTOM
	select BR2_PACKAGE_ZLIB
	help
	  gRPC is Google's protocol buffer based implementation of a
	  remote procedure call protocol.

	  http://www.grpc.io

comment "grpc needs a toolchain w/ C++, threads"
	depends on !(BR2_INSTALL_LIBSTDCPP && BR2_TOOLCHAIN_HAS_THREADS)
```

## package/heading_forwarder/Config.in
```kconfig
config BR2_PACKAGE_HEADING_FORWARDER
  bool "heading_forwarder"
  select BR2_PACKAGE_LIBUV
  select BR2_PACKAGE_LIBSBP
  select BR2_PACKAGE_LIBPIKSI
```

## package/health_daemon/Config.in
```kconfig
config BR2_PACKAGE_HEALTH_DAEMON
  bool "health_daemon"
  select BR2_PACKAGE_LIBUV
  select BR2_PACKAGE_LIBSBP
  select BR2_PACKAGE_LIBPIKSI
  select BR2_PACKAGE_LIBSWIFTNAV
```

## package/image_table_tool/Config.in
```kconfig
config BR2_PACKAGE_IMAGE_TABLE_TOOL
	bool "image_table_tool"
	select BR2_PACKAGE_UBOOT_CUSTOM
	select BR2_PACKAGE_ZLIB
```

## package/libnetwork/Config.in
```kconfig
config BR2_PACKAGE_LIBNETWORK
  bool "libnetwork"
  select BR2_PACKAGE_CZMQ
  select BR2_PACKAGE_LIBSBP
  select BR2_PACKAGE_LIBPIKSI
  select BR2_PACKAGE_LIBCURL
```

## package/libpiksi/Config.in
```kconfig
config BR2_PACKAGE_LIBPIKSI
	bool "libpiksi"
	select BR2_PACKAGE_LIBUV
	select BR2_PACKAGE_NANOMSG_CUSTOM
	select BR2_PACKAGE_LIBSBP
	select BR2_PACKAGE_GTEST if BR2_BUILD_TESTS
```

## package/libsbp_settings/Config.in
```kconfig
config BR2_PACKAGE_LIBSBP_SETTINGS
	bool "libsbp_settings"
	select BR2_PACKAGE_LIBSBP
```

## package/libsbp_zmq/Config.in
```kconfig
config BR2_PACKAGE_LIBSBP_ZMQ
	bool "libsbp_zmq"
	select BR2_PACKAGE_CZMQ
	select BR2_PACKAGE_LIBSBP
```

## package/libsettings/Config.in
```kconfig
config BR2_PACKAGE_LIBSETTINGS
	bool "libsettings"
	select BR2_PACKAGE_LIBSBP
	select BR2_PACKAGE_LIBSWIFTNAV
```

## package/libskylark/Config.in
```kconfig
config BR2_PACKAGE_LIBSKYLARK
  bool "libskylark"
  select BR2_PACKAGE_LIBCURL
  select BR2_PACKAGE_CA_CERTIFICATES
```

## package/metrics_daemon/Config.in
```kconfig
config BR2_PACKAGE_METRICS_DAEMON
  bool "metrics_daemon"
  select BR2_PACKAGE_JSON_C
  select BR2_PACKAGE_LIBUV
  select BR2_PACKAGE_NANOMSG_CUSTOM
  select BR2_PACKAGE_LIBSBP
  select BR2_PACKAGE_LIBPIKSI
  select BR2_PACKAGE_VALGRIND if BR2_BUILD_TESTS
```
