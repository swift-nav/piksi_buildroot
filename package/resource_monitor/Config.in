## package/resource_monitor/Config.in
```kconfig
config BR2_PACKAGE_RESOURCE_MONITOR
  bool "resource_monitor"
  select BR2_PACKAGE_LIBSETTINGS
```

## package/rotating_zmq_logger/Config.in
```kconfig
config BR2_PACKAGE_ROTATING_ZMQ_LOGGER
	bool "rotating_zmq_logger"
	select BR2_PACKAGE_CZMQ
	select BR2_PACKAGE_LIBSBP
	select BR2_PACKAGE_LIBPIKSI
```

## package/rpmsg_stats_daemon/Config.in
```kconfig
config BR2_PACKAGE_RPMSG_STATS_DAEMON
	bool "rpmsg_stats_daemon"
	select BR2_PACKAGE_LIBUV
	select BR2_PACKAGE_LIBPIKSI
  select BR2_PACKAGE_LIBSWIFTNAV
```

## package/rpmsg_stats_protocol/Config.in
```kconfig
config BR2_PACKAGE_RPMSG_STATS_PROTOCOL
	bool "rpmsg_stats_protocol"
  select BR2_PACKAGE_RPMSG_STATS_DAEMON
```

## package/rtcm3_to_sbp_bridge/Config.in
```kconfig
config BR2_PACKAGE_RTCM3_TO_SBP_BRIDGE
	bool "rtcm3_to_sbp_bridge"
	select BR2_PACKAGE_LIBUV
	select BR2_PACKAGE_NANOMSG_CUSTOM
	select BR2_PACKAGE_LIBSBP
	select BR2_PACKAGE_GNSS_CONVERTORS
	select BR2_PACKAGE_LIBPIKSI
```

## package/sample_daemon/Config.in
```kconfig
config BR2_PACKAGE_SAMPLE_DAEMON
  bool "sample_daemon"
  select BR2_PACKAGE_LIBUV
  select BR2_PACKAGE_NANOMSG
  select BR2_PACKAGE_LIBSBP
  select BR2_PACKAGE_LIBPIKSI
```

## package/sbp_anpp_bridge/Config.in
```kconfig
config BR2_PACKAGE_SBP_ANPP_BRIDGE
  bool "sbp_anpp_bridge"
  select BR2_PACKAGE_LIBUV
  select BR2_PACKAGE_LIBSBP
  select BR2_PACKAGE_LIBPIKSI
  select BR2_PACKAGE_LIBSETTINGS
```

## package/sbp_fileio_daemon/Config.in
```kconfig
config BR2_PACKAGE_SBP_FILEIO_DAEMON
	bool "sbp_fileio_daemon"
	select BR2_PACKAGE_CZMQ
	select BR2_PACKAGE_LIBSBP
	select BR2_PACKAGE_LIBSBP_ZMQ
```

## package/sbp_j1939_bridge/Config.in
```kconfig
config BR2_PACKAGE_SBP_J1939_BRIDGE
	bool "sbp_j1939_bridge"
	select BR2_PACKAGE_LIBUV
	select BR2_PACKAGE_LIBSBP
	select BR2_PACKAGE_LIBPIKSI
	select BR2_PACKAGE_LIBSETTINGS
```

## package/sbp_log/Config.in
```kconfig
config BR2_PACKAGE_SBP_LOG
	bool "sbp_log"
	select BR2_PACKAGE_CZMQ
	select BR2_PACKAGE_LIBSBP
```

## package/sbp_nmea2000_bridge/Config.in
```kconfig
config BR2_PACKAGE_SBP_NMEA2000_BRIDGE
	bool "sbp_nmea2000_bridge"
	select BR2_PACKAGE_NANOMSG_CUSTOM
	select BR2_PACKAGE_LIBUV
	select BR2_PACKAGE_LIBNMEA2000
	select BR2_PACKAGE_LIBSBP
	select BR2_PACKAGE_LIBPIKSI
	select BR2_PACKAGE_LIBSOCKETCAN
```

## package/sbp_proto3_bridge/Config.in
```kconfig
config BR2_PACKAGE_SBP_PROTO3_BRIDGE
	bool "sbp_proto3_bridge"
	select BR2_PACKAGE_CZMQ
	select BR2_PACKAGE_LIBSBP
	select BR2_PACKAGE_LIBPIKSI
```

## package/sbp_protobuf_bridge/Config.in
```kconfig
config BR2_PACKAGE_SBP_PROTOBUF_BRIDGE
	bool "sbp_protobuf_bridge"
	select BR2_PACKAGE_CZMQ
	select BR2_PACKAGE_LIBSBP
	select BR2_PACKAGE_LIBPIKSI
```

## package/sbp_rtcm3_bridge/Config.in
```kconfig
config BR2_PACKAGE_SBP_RTCM3_BRIDGE
	bool "sbp_rtcm3_bridge"
	select BR2_PACKAGE_LIBUV
	select BR2_PACKAGE_NANOMSG
	select BR2_PACKAGE_LIBSBP
	select BR2_PACKAGE_GNSS_CONVERTORS
	select BR2_PACKAGE_LIBPIKSI
```

## package/sbp_settings_daemon/Config.in
```kconfig
config BR2_PACKAGE_SBP_SETTINGS_DAEMON
	bool "sbp_settings_daemon"
	select BR2_PACKAGE_LIBUV
	select BR2_PACKAGE_LIBSBP
	select BR2_PACKAGE_LIBPIKSI
	select BR2_PACKAGE_LIBSETTINGS
```

## package/sbp_to_nmea_bridge/Config.in
```kconfig
config BR2_PACKAGE_SBP_NMEA_BRIDGE
	bool "sbp_nmea_bridge"
	select BR2_PACKAGE_LIBUV
	select BR2_PACKAGE_NANOMSG_CUSTOM
	select BR2_PACKAGE_LIBSBP
	select BR2_PACKAGE_GNSS_CONVERTORS
	select BR2_PACKAGE_LIBPIKSI
```

## package/skylark_daemon/Config.in
```kconfig
config BR2_PACKAGE_SKYLARK_DAEMON
  bool "skylark_daemon"
  select BR2_PACKAGE_LIBUV
  select BR2_PACKAGE_LIBSBP
  select BR2_PACKAGE_LIBPIKSI
  select BR2_PACKAGE_LIBCURL
  select BR2_PACKAGE_LIBNETWORK
```

## package/skylark_download_daemon/Config.in
```kconfig
config BR2_PACKAGE_SKYLARK_DOWNLOAD_DAEMON
  bool "skylark_download_daemon"
  select BR2_PACKAGE_CZMQ
  select BR2_PACKAGE_LIBSBP
  select BR2_PACKAGE_LIBPIKSI
  select BR2_PACKAGE_LIBCURL
  select BR2_PACKAGE_LIBSKYLARK
```
