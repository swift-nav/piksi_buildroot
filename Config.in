## Config.in
```kconfig
config BR2_BUILD_TESTS
	bool "Build Tests"
config BR2_RUN_TESTS
	bool "Run Tests"
	depends on BR2_BUILD_TESTS

source "$BR2_EXTERNAL_piksi_buildroot_PATH/package/libsbp/Config.in"
source "$BR2_EXTERNAL_piksi_buildroot_PATH/package/gnss_converters/Config.in"
source "$BR2_EXTERNAL_piksi_buildroot_PATH/package/librtcm/Config.in"
source "$BR2_EXTERNAL_piksi_buildroot_PATH/package/libswiftnav/Config.in"
source "$BR2_EXTERNAL_piksi_buildroot_PATH/package/rpmsg_piksi/Config.in"
source "$BR2_EXTERNAL_piksi_buildroot_PATH/package/upgrade_tool/Config.in"
source "$BR2_EXTERNAL_piksi_buildroot_PATH/package/uboot_custom/Config.in"
source "$BR2_EXTERNAL_piksi_buildroot_PATH/package/llvm_obfuscator/Config.in"
source "$BR2_EXTERNAL_piksi_buildroot_PATH/package/llvm_vanilla/Config.in"
source "$BR2_EXTERNAL_piksi_buildroot_PATH/package/piksi_ins_ref/Config.in"
source "$BR2_EXTERNAL_piksi_buildroot_PATH/package/blackmagic/Config.in"
source "$BR2_EXTERNAL_piksi_buildroot_PATH/package/piksi_ins/Config.in"
source "$BR2_EXTERNAL_piksi_buildroot_PATH/package/piksi_dev_tools/Config.in"
source "$BR2_EXTERNAL_piksi_buildroot_PATH/package/release_lockdown/Config.in"
source "$BR2_EXTERNAL_piksi_buildroot_PATH/package/common_init/Config.in"
source "$BR2_EXTERNAL_piksi_buildroot_PATH/package/grpc_custom/Config.in"
source "$BR2_EXTERNAL_piksi_buildroot_PATH/package/cares_custom/Config.in"
source "$BR2_EXTERNAL_piksi_buildroot_PATH/package/protobuf_custom/Config.in"
source "$BR2_EXTERNAL_piksi_buildroot_PATH/package/starling_daemon/Config.in"
source "$BR2_EXTERNAL_piksi_buildroot_PATH/package/build_tools/Config.in"
source "$BR2_EXTERNAL_piksi_buildroot_PATH/package/libsettings/Config.in"
source "$BR2_EXTERNAL_piksi_buildroot_PATH/package/cmph/Config.in"
source "$BR2_EXTERNAL_piksi_buildroot_PATH/package/bcm_wrapper/Config.in"
source "$BR2_EXTERNAL_piksi_buildroot_PATH/package/piksi_apps/Config.in"
```

## configs/host_defconfig
```kconfig
BR2_GLOBAL_PATCH_DIR="$(BR2_EXTERNAL_piksi_buildroot_PATH)/board/piksiv3/patches"
BR2_x86_64=y
BR2_x86_corei7=y
BR2_TOOLCHAIN_EXTERNAL=y
BR2_TOOLCHAIN_EXTERNAL_DOWNLOAD=y
BR2_TOOLCHAIN_EXTERNAL_URL="https://toolchains.bootlin.com/downloads/releases/toolchains/x86-64-core-i7/tarballs/x86-64-core-i7--glibc--stable-2018.02-2.tar.bz2"
BR2_TOOLCHAIN_EXTERNAL_CUSTOM_PREFIX="$(ARCH)-buildroot-linux-gnu"
BR2_TOOLCHAIN_EXTERNAL_GCC_6=y
BR2_TOOLCHAIN_EXTERNAL_HEADERS_4_1=y
BR2_TOOLCHAIN_EXTERNAL_CUSTOM_GLIBC=y
BR2_TOOLCHAIN_EXTERNAL_CXX=y
BR2_TARGET_GENERIC_HOSTNAME="piksi"
BR2_TARGET_GENERIC_ISSUE="Welcome to Piksi"
BR2_ROOTFS_DEVICE_CREATION_DYNAMIC_MDEV=y
BR2_ROOTFS_DEVICE_TABLE="$(BR2_EXTERNAL_piksi_buildroot_PATH)/board/piksiv3/device_table.txt"
# BR2_TARGET_GENERIC_GETTY is not set
BR2_ROOTFS_OVERLAY="$(BR2_EXTERNAL_piksi_buildroot_PATH)/board/piksiv3/rootfs-overlay"
BR2_PACKAGE_LIBCURL=y
BR2_PACKAGE_OPENSSL=y
BR2_PACKAGE_STRESS=y
BR2_PACKAGE_MTD=y
BR2_PACKAGE_MTD_MKFSJFFS2=y
# BR2_PACKAGE_MTD_NANDDUMP is not set
# BR2_PACKAGE_MTD_NANDTEST is not set
# BR2_PACKAGE_MTD_NANDWRITE is not set
# BR2_PACKAGE_MTD_UBIATTACH is not set
# BR2_PACKAGE_MTD_UBICRC32 is not set
# BR2_PACKAGE_MTD_UBIDETACH is not set
# BR2_PACKAGE_MTD_UBIFORMAT is not set
# BR2_PACKAGE_MTD_UBIMKVOL is not set
# BR2_PACKAGE_MTD_UBINFO is not set
# BR2_PACKAGE_MTD_UBINIZE is not set
# BR2_PACKAGE_MTD_UBIRENAME is not set
# BR2_PACKAGE_MTD_UBIRMVOL is not set
# BR2_PACKAGE_MTD_UBIRSVOL is not set
# BR2_PACKAGE_MTD_UBIUPDATEVOL is not set
# BR2_PACKAGE_MTD_UBIBLOCK is not set
BR2_PACKAGE_CA_CERTIFICATES=y
BR2_PACKAGE_EIGEN=y
BR2_PACKAGE_EIGEN_UNSUPPORTED_MODULES=y
BR2_PACKAGE_ETHTOOL=y
BR2_PACKAGE_LRZSZ=y
BR2_PACKAGE_NTP=y
BR2_PACKAGE_OPENSSH=y
BR2_PACKAGE_SOCAT=y
BR2_PACKAGE_SUDO=y
# BR2_TARGET_ROOTFS_TAR is not set
BR2_BUILD_TESTS=y
BR2_RUN_TESTS=y
BR2_PACKAGE_ZMQ_ROUTER=y
BR2_PACKAGE_ZMQ_ADAPTER=y
BR2_PACKAGE_UPGRADE_TOOL=y
BR2_PACKAGE_SBP_SETTINGS_DAEMON=y
BR2_PACKAGE_FACTORY_DATA_TOOL=y
BR2_PACKAGE_PIKSI_SYSTEM_DAEMON=y
BR2_PACKAGE_SBP_CLI=y
BR2_PACKAGE_IMAGE_TABLE_TOOL=y
BR2_PACKAGE_SBP_FILEIO_DAEMON=y
BR2_PACKAGE_SBP_RTCM3_BRIDGE=y
BR2_PACKAGE_STANDALONE_FILE_LOGGER=y
BR2_PACKAGE_SKYLARK_DAEMON=y
BR2_PACKAGE_NTRIP_DAEMON=y
BR2_PACKAGE_SBP_PROTOCOL=y
BR2_PACKAGE_NMEA_PROTOCOL=y
BR2_PACKAGE_NMEA_DAEMON=y
BR2_PACKAGE_HEALTH_DAEMON=y
BR2_PACKAGE_RTCM3_PROTOCOL=y
BR2_PACKAGE_CELL_MODEM_DAEMON=y
BR2_PACKAGE_LLVM_OBFUSCATOR=y
BR2_PACKAGE_PIKSI_INS_REF=y
BR2_PACKAGE_NETWORK_DAEMON=y
```

## configs/piksi_nano_defconfig
```kconfig
BR2_arm=y
BR2_cortex_a7=y
BR2_ARM_FPU_NEON_VFPV4=y
BR2_GLOBAL_PATCH_DIR="$(BR2_EXTERNAL_piksi_buildroot_PATH)/board/piksi_nano/patches"
BR2_TOOLCHAIN_EXTERNAL=y
BR2_TOOLCHAIN_EXTERNAL_CUSTOM=y
BR2_TOOLCHAIN_EXTERNAL_DOWNLOAD=y
BR2_TOOLCHAIN_EXTERNAL_URL="http://toolchains.free-electrons.com/downloads/releases/toolchains/armv7-eabihf/tarballs/armv7-eabihf--glibc--stable-2018.02-2.tar.bz2"
BR2_TOOLCHAIN_EXTERNAL_GCC_6=y
BR2_TOOLCHAIN_EXTERNAL_HEADERS_4_1=y
BR2_TOOLCHAIN_EXTERNAL_CUSTOM_GLIBC=y
BR2_TOOLCHAIN_EXTERNAL_CXX=y
BR2_TOOLCHAIN_EXTERNAL_GDB_SERVER_COPY=y
BR2_TOOLCHAIN_GLIBC_GCONV_LIBS_COPY=y
BR2_TARGET_GENERIC_HOSTNAME="piksi"
BR2_TARGET_GENERIC_ISSUE="Welcome to Piksi"
BR2_ROOTFS_DEVICE_CREATION_DYNAMIC_MDEV=y
BR2_ROOTFS_DEVICE_TABLE="$(BR2_EXTERNAL_piksi_buildroot_PATH)/board/piksi_nano/device_table.txt"
# BR2_TARGET_GENERIC_GETTY is not set
BR2_ROOTFS_OVERLAY="$(BR2_EXTERNAL_piksi_buildroot_PATH)/board/piksi_nano/rootfs-overlay"
BR2_ROOTFS_POST_IMAGE_SCRIPT="$(BR2_EXTERNAL_piksi_buildroot_PATH)/board/piksi_nano/post-image.sh"
BR2_LINUX_KERNEL=y
BR2_LINUX_KERNEL_CUSTOM_VERSION=y
BR2_LINUX_KERNEL_CUSTOM_VERSION_VALUE="4.14.28"
BR2_LINUX_KERNEL_USE_CUSTOM_CONFIG=y
BR2_LINUX_KERNEL_CUSTOM_CONFIG_FILE="$(BR2_EXTERNAL_piksi_buildroot_PATH)/board/piksi_nano/linux.config"
BR2_LINUX_KERNEL_LZ4=y
BR2_LINUX_KERNEL_DTS_SUPPORT=y
BR2_LINUX_KERNEL_USE_CUSTOM_DTS=y
BR2_LINUX_KERNEL_CUSTOM_DTS_PATH="$(BR2_EXTERNAL_piksi_buildroot_PATH)/board/piksi_nano/piksi_nano.dts"
BR2_PACKAGE_LINUX_TOOLS_PERF=y
BR2_PACKAGE_BUSYBOX_CONFIG="$(BR2_EXTERNAL_piksi_buildroot_PATH)/board/piksiv3/busybox.config"
BR2_PACKAGE_BUSYBOX_SHOW_OTHERS=y
BR2_PACKAGE_F2FS_TOOLS=y
BR2_PACKAGE_MTD=y
BR2_PACKAGE_MTD_MKFSJFFS2=y
# BR2_PACKAGE_MTD_NANDDUMP is not set
# BR2_PACKAGE_MTD_NANDTEST is not set
# BR2_PACKAGE_MTD_NANDWRITE is not set
# BR2_PACKAGE_MTD_UBIATTACH is not set
# BR2_PACKAGE_MTD_UBICRC32 is not set
# BR2_PACKAGE_MTD_UBIDETACH is not set
# BR2_PACKAGE_MTD_UBIFORMAT is not set
# BR2_PACKAGE_MTD_UBIMKVOL is not set
# BR2_PACKAGE_MTD_UBINFO is not set
# BR2_PACKAGE_MTD_UBINIZE is not set
# BR2_PACKAGE_MTD_UBIRENAME is not set
# BR2_PACKAGE_MTD_UBIRMVOL is not set
# BR2_PACKAGE_MTD_UBIRSVOL is not set
# BR2_PACKAGE_MTD_UBIUPDATEVOL is not set
# BR2_PACKAGE_MTD_UBIBLOCK is not set
BR2_PACKAGE_PICOCOM=y
BR2_PACKAGE_CA_CERTIFICATES=y
BR2_PACKAGE_OPENSSL=y
BR2_PACKAGE_C_ARES=y
BR2_PACKAGE_EIGEN=y
BR2_PACKAGE_EIGEN_UNSUPPORTED_MODULES=y
BR2_PACKAGE_LIBCAP=y
BR2_PACKAGE_LIBCAP_TOOLS=y
BR2_PACKAGE_CAN_UTILS=y
BR2_PACKAGE_DHCPCD=y
BR2_PACKAGE_DROPBEAR=y
BR2_PACKAGE_ETHTOOL=y
BR2_PACKAGE_IPROUTE2=y
BR2_PACKAGE_LRZSZ=y
BR2_PACKAGE_NTP=y
BR2_PACKAGE_PPPD=y
BR2_PACKAGE_RSYNC=y
BR2_PACKAGE_SOCAT=y
BR2_PACKAGE_INOTIFY_TOOLS=y
BR2_PACKAGE_SUDO=y
BR2_PACKAGE_KMOD=y
BR2_PACKAGE_KMOD_TOOLS=y
BR2_PACKAGE_UTIL_LINUX_BINARIES=y
BR2_PACKAGE_UTIL_LINUX_FSCK=y
BR2_TARGET_ROOTFS_EXT2=y
BR2_TARGET_ROOTFS_EXT2_4=y
# BR2_TARGET_ROOTFS_TAR is not set
BR2_TARGET_UBOOT=y
BR2_TARGET_UBOOT_BOARDNAME="mx6ul_var_dart_mmc"
BR2_TARGET_UBOOT_CUSTOM_GIT=y
BR2_TARGET_UBOOT_CUSTOM_REPO_URL="https://github.com/varigit/uboot-imx"
BR2_TARGET_UBOOT_CUSTOM_REPO_VERSION="imx_v2017.03_4.9.11_1.0.0_ga_var01"
# BR2_TARGET_UBOOT_FORMAT_BIN is not set
BR2_TARGET_UBOOT_FORMAT_IMG=y
BR2_TARGET_UBOOT_SPL=y
BR2_TARGET_UBOOT_SPL_NAME="SPL"
BR2_PACKAGE_HOST_DOSFSTOOLS=y
BR2_PACKAGE_HOST_DTC=y
BR2_PACKAGE_HOST_GENIMAGE=y
BR2_PACKAGE_HOST_MTOOLS=y
BR2_PACKAGE_HOST_UBOOT_TOOLS=y
BR2_PACKAGE_ENDPOINT_ROUTER=y
BR2_PACKAGE_ENDPOINT_ADAPTER=y
BR2_PACKAGE_SBP_SETTINGS_DAEMON=y
BR2_PACKAGE_PIKSI_SYSTEM_DAEMON=y
BR2_PACKAGE_SBP_CLI=y
BR2_PACKAGE_SBP_FILEIO_DAEMON=y
BR2_PACKAGE_SBP_RTCM3_BRIDGE=y
BR2_PACKAGE_STANDALONE_FILE_LOGGER=y
BR2_PACKAGE_SKYLARK_DAEMON=y
BR2_PACKAGE_NTRIP_DAEMON=y
BR2_PACKAGE_SAMPLE_DAEMON=y
BR2_PACKAGE_SBP_PROTOCOL=y
BR2_PACKAGE_NMEA_DAEMON=y
BR2_PACKAGE_NMEA_PROTOCOL=y
BR2_PACKAGE_HEALTH_DAEMON=y
BR2_PACKAGE_RTCM3_PROTOCOL=y
BR2_PACKAGE_CELL_MODEM_DAEMON=y
BR2_PACKAGE_PIKSI_LEDS=y
BR2_PACKAGE_LLVM_OBFUSCATOR=y
BR2_PACKAGE_PIKSI_INS_REF=n
BR2_PACKAGE_NETWORK_DAEMON=y
BR2_PACKAGE_PORTS_DAEMON=y
BR2_PACKAGE_PIKSI_DEV_TOOLS=y
BR2_PACKAGE_COMMON_INIT=y
```

## configs/piksiv3_defconfig
```kconfig
BR2_arm=y
BR2_cortex_a9=y
BR2_ARM_ENABLE_NEON=y
BR2_ARM_ENABLE_VFP=y
BR2_ARM_FPU_NEON=y
BR2_GLOBAL_PATCH_DIR="$(BR2_EXTERNAL_piksi_buildroot_PATH)/board/piksiv3/patches"
BR2_TOOLCHAIN_EXTERNAL=y
BR2_TARGET_GENERIC_HOSTNAME="piksi"
BR2_TARGET_GENERIC_ISSUE="Welcome to Piksi"
BR2_ROOTFS_DEVICE_CREATION_DYNAMIC_MDEV=y
BR2_ROOTFS_DEVICE_TABLE="$(BR2_EXTERNAL_piksi_buildroot_PATH)/board/piksiv3/device_table.txt"
# BR2_TARGET_GENERIC_GETTY is not set
BR2_ROOTFS_OVERLAY="$(BR2_EXTERNAL_piksi_buildroot_PATH)/board/piksiv3/rootfs-overlay"
BR2_ROOTFS_POST_BUILD_SCRIPT="$(BR2_EXTERNAL_piksi_buildroot_PATH)/board/piksiv3/post_build.sh"
BR2_ROOTFS_POST_IMAGE_SCRIPT="$(BR2_EXTERNAL_piksi_buildroot_PATH)/board/piksiv3/post_image.sh"
BR2_LINUX_KERNEL=y
BR2_LINUX_KERNEL_CUSTOM_GIT=y
BR2_LINUX_KERNEL_CUSTOM_REPO_URL="git://github.com/Xilinx/linux-xlnx.git"
BR2_LINUX_KERNEL_CUSTOM_REPO_VERSION="xilinx-v2016.4"
BR2_LINUX_KERNEL_USE_CUSTOM_CONFIG=y
BR2_LINUX_KERNEL_CUSTOM_CONFIG_FILE="$(BR2_EXTERNAL_piksi_buildroot_PATH)/board/piksiv3/linux.config"
BR2_LINUX_KERNEL_APPENDED_UIMAGE=y
BR2_LINUX_KERNEL_LZ4=y
BR2_LINUX_KERNEL_UIMAGE_LOADADDR="0x00108000"
BR2_LINUX_KERNEL_USE_CUSTOM_DTS=y
BR2_LINUX_KERNEL_CUSTOM_DTS_PATH="$(BR2_EXTERNAL_piksi_buildroot_PATH)/board/piksiv3/piksiv3.dtsi $(BR2_EXTERNAL_piksi_buildroot_PATH)/board/piksiv3/piksiv3_microzed.dts $(BR2_EXTERNAL_piksi_buildroot_PATH)/board/piksiv3/piksiv3_prod.dts"
BR2_PACKAGE_BUSYBOX_CONFIG="$(BR2_EXTERNAL_piksi_buildroot_PATH)/board/piksiv3/busybox.config"
BR2_PACKAGE_BUSYBOX_SHOW_OTHERS=y
BR2_PACKAGE_STRACE=y
BR2_PACKAGE_LINUX_TOOLS_PERF=y
BR2_PACKAGE_GDB=y
BR2_PACKAGE_STRESS=y
BR2_PACKAGE_MTD=y
BR2_PACKAGE_MTD_MKFSJFFS2=y
# BR2_PACKAGE_MTD_NANDDUMP is not set
# BR2_PACKAGE_MTD_NANDTEST is not set
# BR2_PACKAGE_MTD_NANDWRITE is not set
# BR2_PACKAGE_MTD_UBIATTACH is not set
# BR2_PACKAGE_MTD_UBICRC32 is not set
# BR2_PACKAGE_MTD_UBIDETACH is not set
# BR2_PACKAGE_MTD_UBIFORMAT is not set
# BR2_PACKAGE_MTD_UBIMKVOL is not set
# BR2_PACKAGE_MTD_UBINFO is not set
# BR2_PACKAGE_MTD_UBINIZE is not set
# BR2_PACKAGE_MTD_UBIRENAME is not set
# BR2_PACKAGE_MTD_UBIRMVOL is not set
# BR2_PACKAGE_MTD_UBIRSVOL is not set
# BR2_PACKAGE_MTD_UBIUPDATEVOL is not set
# BR2_PACKAGE_MTD_UBIBLOCK is not set
BR2_PACKAGE_CA_CERTIFICATES=y
BR2_PACKAGE_C_ARES=y
BR2_PACKAGE_EIGEN=y
BR2_PACKAGE_EIGEN_UNSUPPORTED_MODULES=y
BR2_PACKAGE_CAN_UTILS=y
BR2_PACKAGE_DHCPCD=y
BR2_PACKAGE_ETHTOOL=y
BR2_PACKAGE_IPROUTE2=y
BR2_PACKAGE_LRZSZ=y
BR2_PACKAGE_NTP=y
BR2_PACKAGE_OPENSSH=y
BR2_PACKAGE_PICOCOM=y
BR2_PACKAGE_PPPD=y
BR2_PACKAGE_SOCAT=y
BR2_PACKAGE_SUDO=y
BR2_PACKAGE_KMOD=y
BR2_PACKAGE_KMOD_TOOLS=y
BR2_PACKAGE_MONIT=y
BR2_TARGET_ROOTFS_INITRAMFS=y
# BR2_TARGET_ROOTFS_TAR is not set
BR2_PACKAGE_RPMSG_PIKSI=y
BR2_PACKAGE_ZMQ_ROUTER=y
BR2_PACKAGE_ZMQ_ADAPTER=y
BR2_PACKAGE_UPGRADE_TOOL=y
BR2_PACKAGE_UBOOT_CUSTOM_CONFIGS="piksiv3_prod_prod piksiv3_prod_failsafe piksiv3_prod_dev"
BR2_PACKAGE_SBP_SETTINGS_DAEMON=y
BR2_PACKAGE_FACTORY_DATA_TOOL=y
BR2_PACKAGE_PIKSI_SYSTEM_DAEMON=y
BR2_PACKAGE_SBP_LOG=y
BR2_PACKAGE_IMAGE_TABLE_TOOL=y
BR2_PACKAGE_SBP_FILEIO_DAEMON=y
BR2_PACKAGE_SBP_RTCM3_BRIDGE=y
BR2_PACKAGE_STANDALONE_FILE_LOGGER=y
BR2_PACKAGE_SKYLARK_DOWNLOAD_DAEMON=y
BR2_PACKAGE_SKYLARK_UPLOAD_DAEMON=y
BR2_PACKAGE_NTRIP_DAEMON=y
BR2_PACKAGE_SAMPLE_DAEMON=y
BR2_PACKAGE_SBP_PROTOCOL=y
BR2_PACKAGE_NMEA_PROTOCOL=y
BR2_PACKAGE_NMEA_DAEMON=y
BR2_PACKAGE_HEALTH_DAEMON=y
BR2_PACKAGE_RTCM3_PROTOCOL=y
BR2_PACKAGE_PIKSI_LEDS=y
BR2_PACKAGE_LLVM_OBFUSCATOR=y
BR2_PACKAGE_PIKSI_INS_REF=y
BR2_PACKAGE_BLACKMAGIC=y
BR2_PACKAGE_PIKSI_INS=y
```

## configs/piksiv3_stage1_defconfig
```kconfig
BR2_arm=y
BR2_cortex_a9=y
BR2_ARM_ENABLE_NEON=y
BR2_ARM_ENABLE_VFP=y
BR2_ARM_FPU_NEON=y
BR2_CCACHE=y
BR2_GLOBAL_PATCH_DIR="$(BR2_EXTERNAL_piksi_buildroot_PATH)/board/piksiv3/patches"
BR2_TOOLCHAIN_EXTERNAL=y
BR2_TARGET_GENERIC_HOSTNAME="piksi"
BR2_TARGET_GENERIC_ISSUE="Welcome to Piksi"
BR2_ROOTFS_DEVICE_CREATION_DYNAMIC_MDEV=y
BR2_ROOTFS_DEVICE_TABLE="$(BR2_EXTERNAL_piksi_buildroot_PATH)/board/piksiv3/device_table_stage1.txt"
# BR2_TARGET_GENERIC_GETTY is not set
BR2_ROOTFS_OVERLAY="$(BR2_EXTERNAL_piksi_buildroot_PATH)/board/piksiv3/stage1-rootfs-overlay"
BR2_ROOTFS_POST_BUILD_SCRIPT="$(BR2_EXTERNAL_piksi_buildroot_PATH)/board/piksiv3/post_build_stage1.sh"
BR2_ROOTFS_POST_IMAGE_SCRIPT="$(BR2_EXTERNAL_piksi_buildroot_PATH)/board/piksiv3/post_image_stage1.sh"
BR2_LINUX_KERNEL=y
BR2_LINUX_KERNEL_CUSTOM_GIT=y
BR2_LINUX_KERNEL_CUSTOM_REPO_URL="git://github.com/Xilinx/linux-xlnx.git"
BR2_LINUX_KERNEL_CUSTOM_REPO_VERSION="xilinx-v2016.4"
BR2_LINUX_KERNEL_USE_CUSTOM_CONFIG=y
BR2_LINUX_KERNEL_CUSTOM_CONFIG_FILE="$(BR2_EXTERNAL_piksi_buildroot_PATH)/board/piksiv3/linux.config"
BR2_LINUX_KERNEL_APPENDED_UIMAGE=y
BR2_LINUX_KERNEL_LZ4=y
BR2_LINUX_KERNEL_UIMAGE_LOADADDR="0x00108000"
BR2_LINUX_KERNEL_USE_CUSTOM_DTS=y
BR2_LINUX_KERNEL_CUSTOM_DTS_PATH="$(BR2_EXTERNAL_piksi_buildroot_PATH)/board/piksiv3/piksiv3.dtsi $(BR2_EXTERNAL_piksi_buildroot_PATH)/board/piksiv3/piksiv3_microzed.dts $(BR2_EXTERNAL_piksi_buildroot_PATH)/board/piksiv3/piksiv3_prod.dts"
BR2_PACKAGE_BUSYBOX_CONFIG="$(BR2_EXTERNAL_piksi_buildroot_PATH)/board/piksiv3/busybox.config"
BR2_PACKAGE_BUSYBOX_SHOW_OTHERS=y
BR2_PACKAGE_MTD=y
BR2_PACKAGE_MTD_MKFSJFFS2=y
BR2_PACKAGE_KMOD=y
BR2_PACKAGE_KMOD_TOOLS=y
BR2_TARGET_ROOTFS_INITRAMFS=y
```
