## configs/piksiv3_stage2_defconfig
```kconfig
BR2_arm=y
BR2_cortex_a9=y
BR2_ARM_ENABLE_NEON=y
BR2_ARM_ENABLE_VFP=y
BR2_ARM_FPU_NEON=y
BR2_CCACHE=y
BR2_GLOBAL_PATCH_DIR="$(BR2_EXTERNAL_piksi_buildroot_PATH)/board/piksiv3/patches"
BR2_TOOLCHAIN_EXTERNAL=y
BR2_TARGET_GENERIC_HOSTNAME="piksi"
BR2_TARGET_GENERIC_ISSUE="Welcome to Piksi"
BR2_SYSTEM_BIN_SH_NONE=y
BR2_ROOTFS_OVERLAY="$(BR2_EXTERNAL_piksi_buildroot_PATH)/board/piksiv3/stage2-rootfs-overlay"
BR2_ROOTFS_POST_BUILD_SCRIPT="$(BR2_EXTERNAL_piksi_buildroot_PATH)/board/piksiv3/post_build_stage2.sh"
BR2_ROOTFS_POST_IMAGE_SCRIPT="$(BR2_EXTERNAL_piksi_buildroot_PATH)/board/piksiv3/post_image_stage2.sh"
BR2_ROOTFS_POST_FAKEROOT_SCRIPT="$(BR2_EXTERNAL_piksi_buildroot_PATH)/board/piksiv3/post_fakeroot_stage2.sh"
BR2_ROOTFS_DEVICE_TABLE="$(BR2_EXTERNAL_piksi_buildroot_PATH)/board/piksiv3/device_table_stage2.txt"
BR2_PACKAGE_CA_CERTIFICATES=y
BR2_PACKAGE_C_ARES=y
BR2_PACKAGE_EIGEN=y
BR2_PACKAGE_EIGEN_UNSUPPORTED_MODULES=y
BR2_PACKAGE_CAN_UTILS=y
BR2_PACKAGE_DHCPCD=y
BR2_PACKAGE_ETHTOOL=y
BR2_PACKAGE_IPROUTE2=y
BR2_PACKAGE_LRZSZ=y
BR2_PACKAGE_NTP=y
BR2_PACKAGE_OPENSSH=y
BR2_PACKAGE_PPPD=y
BR2_PACKAGE_SOCAT=y
BR2_PACKAGE_SUDO=y
BR2_PACKAGE_KMOD=y
BR2_PACKAGE_KMOD_TOOLS=y
BR2_PACKAGE_MONIT=y
BR2_TARGET_ROOTFS_SQUASHFS=y
BR2_TARGET_ROOTFS_SQUASHFS4_LZ4=y
# BR2_TARGET_ROOTFS_TAR is not set
BR2_PACKAGE_ZMQ_ROUTER=y
BR2_PACKAGE_ZMQ_ADAPTER=y
BR2_PACKAGE_UPGRADE_TOOL=y
BR2_PACKAGE_UBOOT_CUSTOM_CONFIGS="piksiv3_prod_prod piksiv3_prod_failsafe piksiv3_prod_dev"
BR2_PACKAGE_SBP_SETTINGS_DAEMON=y
BR2_PACKAGE_FACTORY_DATA_TOOL=y
BR2_PACKAGE_PIKSI_SYSTEM_DAEMON=y
BR2_PACKAGE_SBP_LOG=y
BR2_PACKAGE_IMAGE_TABLE_TOOL=y
BR2_PACKAGE_SBP_FILEIO_DAEMON=y
BR2_PACKAGE_SBP_RTCM3_BRIDGE=y
BR2_PACKAGE_STANDALONE_FILE_LOGGER=y
BR2_PACKAGE_SKYLARK_DOWNLOAD_DAEMON=y
BR2_PACKAGE_SKYLARK_UPLOAD_DAEMON=y
BR2_PACKAGE_NTRIP_DAEMON=y
BR2_PACKAGE_SAMPLE_DAEMON=y
BR2_PACKAGE_SBP_PROTOCOL=y
BR2_PACKAGE_NMEA_DAEMON=y
BR2_PACKAGE_NMEA_PROTOCOL=y
BR2_PACKAGE_HEALTH_DAEMON=y
BR2_PACKAGE_RTCM3_PROTOCOL=y
BR2_PACKAGE_PIKSI_LEDS=y
BR2_PACKAGE_LLVM_OBFUSCATOR=y
BR2_PACKAGE_PIKSI_INS_REF=y
BR2_PACKAGE_BLACKMAGIC=y
```

## configs/piksiv4_defconfig
```kconfig
BR2_aarch64=y
BR2_CCACHE=y
BR2_CCACHE_DIR="$(BR2_EXTERNAL_piksi_buildroot_PATH)/buildroot/output/ccache"
BR2_ENABLE_DEBUG=y
BR2_GLOBAL_PATCH_DIR="$(BR2_EXTERNAL_piksi_buildroot_PATH)/board/piksiv4/patches"
BR2_TOOLCHAIN_EXTERNAL=y
BR2_TOOLCHAIN_EXTERNAL_CUSTOM=y
BR2_TOOLCHAIN_EXTERNAL_DOWNLOAD=y
BR2_TOOLCHAIN_EXTERNAL_URL="https://toolchains.bootlin.com/downloads/releases/toolchains/aarch64/tarballs/aarch64--glibc--stable-2018.02-2.tar.bz2"
BR2_TOOLCHAIN_EXTERNAL_GCC_6=y
BR2_TOOLCHAIN_EXTERNAL_HEADERS_4_1=y
BR2_TOOLCHAIN_EXTERNAL_CUSTOM_GLIBC=y
BR2_TOOLCHAIN_EXTERNAL_CXX=y
BR2_TOOLCHAIN_GLIBC_GCONV_LIBS_COPY=y
BR2_TARGET_OPTIMIZATION="-flto"
BR2_TARGET_LDFLAGS="-flto"
BR2_TARGET_GENERIC_HOSTNAME="piksi"
BR2_TARGET_GENERIC_ISSUE="Welcome to Piksi"
BR2_ROOTFS_DEVICE_CREATION_DYNAMIC_MDEV=y
BR2_ROOTFS_DEVICE_TABLE="$(BR2_EXTERNAL_piksi_buildroot_PATH)/board/piksiv4/device_table.txt"
# BR2_TARGET_GENERIC_GETTY is not set
BR2_ROOTFS_USERS_TABLES="$(BR2_EXTERNAL_piksi_buildroot_PATH)/board/piksiv4/users_table.txt"
BR2_ROOTFS_OVERLAY="$(BR2_EXTERNAL_piksi_buildroot_PATH)/board/piksiv4/rootfs-overlay"
BR2_ROOTFS_POST_BUILD_SCRIPT="$(BR2_EXTERNAL_piksi_buildroot_PATH)/board/piksiv4/post_build.sh"
BR2_ROOTFS_POST_IMAGE_SCRIPT="$(BR2_EXTERNAL_piksi_buildroot_PATH)/board/piksiv4/post_image.sh"
BR2_LINUX_KERNEL=y
BR2_LINUX_KERNEL_CUSTOM_GIT=y
BR2_LINUX_KERNEL_CUSTOM_REPO_URL="git://github.com/Xilinx/linux-xlnx.git"
BR2_LINUX_KERNEL_CUSTOM_REPO_VERSION="xilinx-v2018.3"
BR2_LINUX_KERNEL_USE_CUSTOM_CONFIG=y
BR2_LINUX_KERNEL_CUSTOM_CONFIG_FILE="$(BR2_EXTERNAL_piksi_buildroot_PATH)/board/piksiv4/linux.config"
BR2_LINUX_KERNEL_LZ4=y
BR2_LINUX_KERNEL_DTS_SUPPORT=y
BR2_LINUX_KERNEL_CUSTOM_DTS_PATH="$(BR2_EXTERNAL_piksi_buildroot_PATH)/board/piksiv4/piksiv4.dts"
BR2_PACKAGE_BUSYBOX_CONFIG="$(BR2_EXTERNAL_piksi_buildroot_PATH)/board/piksiv4/busybox.config"
BR2_PACKAGE_BUSYBOX_SHOW_OTHERS=y
BR2_PACKAGE_GDB=y
BR2_PACKAGE_F2FS_TOOLS=y
BR2_PACKAGE_MTD=y
BR2_PACKAGE_MTD_MKFSJFFS2=y
# BR2_PACKAGE_MTD_NANDDUMP is not set
# BR2_PACKAGE_MTD_NANDTEST is not set
# BR2_PACKAGE_MTD_NANDWRITE is not set
# BR2_PACKAGE_MTD_UBIATTACH is not set
# BR2_PACKAGE_MTD_UBICRC32 is not set
# BR2_PACKAGE_MTD_UBIDETACH is not set
# BR2_PACKAGE_MTD_UBIFORMAT is not set
# BR2_PACKAGE_MTD_UBIMKVOL is not set
# BR2_PACKAGE_MTD_UBINFO is not set
# BR2_PACKAGE_MTD_UBINIZE is not set
# BR2_PACKAGE_MTD_UBIRENAME is not set
# BR2_PACKAGE_MTD_UBIRMVOL is not set
# BR2_PACKAGE_MTD_UBIRSVOL is not set
# BR2_PACKAGE_MTD_UBIUPDATEVOL is not set
# BR2_PACKAGE_MTD_UBIBLOCK is not set
BR2_PACKAGE_PICOCOM=y
BR2_PACKAGE_CA_CERTIFICATES=y
BR2_PACKAGE_LIBCAP=y
BR2_PACKAGE_LIBCAP_TOOLS=y
BR2_PACKAGE_DHCPCD=y
BR2_PACKAGE_DROPBEAR=y
BR2_PACKAGE_DROPBEAR_DISABLE_REVERSEDNS=y
BR2_PACKAGE_ETHTOOL=y
BR2_PACKAGE_LRZSZ=y
BR2_PACKAGE_NTP=y
BR2_PACKAGE_PPPD=y
BR2_PACKAGE_RSYNC=y
BR2_PACKAGE_SOCAT=y
BR2_PACKAGE_INOTIFY_TOOLS=y
BR2_PACKAGE_LOGROTATE=y
BR2_PACKAGE_SUDO=y
BR2_PACKAGE_KMOD=y
BR2_PACKAGE_KMOD_TOOLS=y
BR2_PACKAGE_PROCPS_NG=y
BR2_PACKAGE_UTIL_LINUX_BINARIES=y
BR2_PACKAGE_UTIL_LINUX_FSCK=y
BR2_TARGET_ROOTFS_INITRAMFS=y
# BR2_TARGET_ROOTFS_TAR is not set
BR2_TARGET_ARM_TRUSTED_FIRMWARE=y
BR2_TARGET_ARM_TRUSTED_FIRMWARE_CUSTOM_GIT=y
BR2_TARGET_ARM_TRUSTED_FIRMWARE_CUSTOM_REPO_URL="https://github.com/xilinx/arm-trusted-firmware"
BR2_TARGET_ARM_TRUSTED_FIRMWARE_CUSTOM_REPO_VERSION="xilinx-v2018.3"
BR2_TARGET_ARM_TRUSTED_FIRMWARE_PLATFORM="zynqmp"
BR2_TARGET_ARM_TRUSTED_FIRMWARE_BL31=y
BR2_TARGET_UBOOT=y
BR2_TARGET_UBOOT_BUILD_SYSTEM_KCONFIG=y
BR2_TARGET_UBOOT_CUSTOM_GIT=y
BR2_TARGET_UBOOT_CUSTOM_REPO_URL="https://github.com/Xilinx/u-boot-xlnx"
BR2_TARGET_UBOOT_CUSTOM_REPO_VERSION="xilinx-v2018.3"
BR2_TARGET_UBOOT_USE_CUSTOM_CONFIG=y
BR2_TARGET_UBOOT_CUSTOM_CONFIG_FILE="$(BR2_EXTERNAL_piksi_buildroot_PATH)/board/piksiv4/uboot.config"
# BR2_TARGET_UBOOT_FORMAT_BIN is not set
BR2_TARGET_UBOOT_FORMAT_ELF=y
BR2_PACKAGE_HOST_DTC=y
BR2_PACKAGE_HOST_UBOOT_TOOLS=y
BR2_PACKAGE_RPMSG_PIKSI=y
BR2_PACKAGE_ENDPOINT_ROUTER=y
BR2_PACKAGE_ENDPOINT_ADAPTER=y
BR2_PACKAGE_SBP_SETTINGS_DAEMON=y
BR2_PACKAGE_PIKSI_SYSTEM_DAEMON=y
BR2_PACKAGE_SBP_CLI=y
BR2_PACKAGE_SBP_RTCM3_BRIDGE=y
BR2_PACKAGE_STANDALONE_FILE_LOGGER=y
BR2_PACKAGE_NTRIP_DAEMON=y
BR2_PACKAGE_SAMPLE_DAEMON=y
BR2_PACKAGE_SBP_PROTOCOL=y
BR2_PACKAGE_NMEA_DAEMON=y
BR2_PACKAGE_PFW_WELCOME=y
BR2_PACKAGE_NMEA_PROTOCOL=y
BR2_PACKAGE_SBP_NMEA_BRIDGE=y
BR2_PACKAGE_HEALTH_DAEMON=y
BR2_PACKAGE_RTCM3_IN_PROTOCOL=y
BR2_PACKAGE_RTCM3_OUT_PROTOCOL=y
BR2_PACKAGE_CELL_MODEM_DAEMON=y
BR2_PACKAGE_PIKSI_LEDS=y
BR2_PACKAGE_LLVM_VANILLA=y
BR2_PACKAGE_PIKSI_INS_REF=y
BR2_PACKAGE_NETWORK_DAEMON=y
BR2_PACKAGE_PORTS_DAEMON=y
BR2_PACKAGE_PIKSI_INS=y
BR2_PIKSI_DEV_TOOLS=y
BR2_PACKAGE_COMMON_INIT=y
BR2_PACKAGE_QUERY_CONFIG=y
BR2_PACKAGE_STARLING_DAEMON=y
BR2_PACKAGE_BUILD_TOOLS=y
BR2_PACKAGE_METRICS_DAEMON=y
BR2_PACKAGE_RESOURCE_MONITOR=y
BR2_PACKAGE_CMPH=y
```

## package/anpp_protocol/Config.in
```kconfig
config BR2_PACKAGE_ANPP_PROTOCOL
  bool "anpp_protocol"
  select BR2_PACKAGE_LIBPIKSI
```

## package/bcm_wrapper/Config.in
```kconfig
config BR2_PACKAGE_BCM_WRAPPER
  bool "bcm_wrapper"
  select BR2_PACKAGE_LIBUV
  select BR2_PACKAGE_LIBSBP
  select BR2_PACKAGE_LIBPIKSI
```

## package/cares_custom/Config.in
```kconfig
config BR2_PACKAGE_CARES_CUSTOM
	bool "cares_custom"
	help
	  C library for asynchronous DNS requests.

	  http://c-ares.haxx.se/
```

## package/cell_modem_daemon/Config.in
```kconfig
config BR2_PACKAGE_CELL_MODEM_DAEMON
  bool "cell_modem_daemon"
  select BR2_PACKAGE_LIBUV
  select BR2_PACKAGE_LIBSBP
  select BR2_PACKAGE_LIBPIKSI
```

## package/cmph/Config.in
```kconfig
config BR2_PACKAGE_CMPH
	bool "cmph"
	help
	  CMPH - C Minimal Perfect Hash
	  http://cmph.sourceforge.net/
```

## package/csac_daemon/Config.in
```kconfig
config BR2_PACKAGE_CSAC_DAEMON
  bool "csac_daemon"
  select BR2_PACKAGE_LIBUV
  select BR2_PACKAGE_NANOMSG_CUSTOM
  select BR2_PACKAGE_LIBSBP
  select BR2_PACKAGE_LIBPIKSI
```

## package/endpoint_adapter/Config.in
```kconfig
config BR2_PACKAGE_ENDPOINT_ADAPTER
	bool "endpoint_adapter"
	select BR2_PACKAGE_NANOMSG_CUSTOM
	select BR2_PACKAGE_LIBSBP
	select BR2_PACKAGE_LIBPIKSI
```
